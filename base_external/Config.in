## base_external/Config.in
```kconfig
source "$BR2_EXTERNAL_project_base_PATH/package/char_driver_app/Config.in"
source "$BR2_EXTERNAL_project_base_PATH/package/char_driver_knod/Config.in"
```

## base_external/package/aesd-project/Config.in
```kconfig
config BR2_PACKAGE_AESD_PROJECT
    bool "aesd-project"
    help
      Enable I2C Accelerometer Character Driver Project.
      This will build and install your application and setup scripts
      into /usr/bin and /etc/init.d respectively.
```

## base_external/package/char_driver_app/Config.in
```kconfig
config BR2_PACKAGE_CHAR_DRIVER_APP
    bool "char_driver demo & test applications"
    help
      Builds and installs the user-space tools:
      - lsm9ds1_test
      - gpio_test
      - demo_app
```

## base_external/package/char_driver_knod/Config.in
```kconfig
config BR2_PACKAGE_CHAR_DRIVER_KMOD
    bool "char_driver kernel module"
    depends on BR2_LINUX_KERNEL
    help
      Builds and installs the accel I²C driver as a kernel module.
```

## base_external/package/ldd/Config.in
```kconfig
config BR2_PACKAGE_LDD
    bool "ldd"
    help
        Installs misc-modules and scull modules into the root filesystem.
```
